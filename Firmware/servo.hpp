/**********************************************************************************
BSD 3-Clause License

Copyright (c) 2022, Orso Eric
All rights reserved.

Redistribution and use in source and binary forms, with or without
modification, are permitted provided that the following conditions are met:

1. Redistributions of source code must retain the above copyright notice, this
   list of conditions and the following disclaimer.

2. Redistributions in binary form must reproduce the above copyright notice,
   this list of conditions and the following disclaimer in the documentation
   and/or other materials provided with the distribution.

3. Neither the name of the copyright holder nor the names of its
   contributors may be used to endorse or promote products derived from
   this software without specific prior written permission.

THIS SOFTWARE IS PROVIDED BY THE COPYRIGHT HOLDERS AND CONTRIBUTORS "AS IS"
AND ANY EXPRESS OR IMPLIED WARRANTIES, INCLUDING, BUT NOT LIMITED TO, THE
IMPLIED WARRANTIES OF MERCHANTABILITY AND FITNESS FOR A PARTICULAR PURPOSE ARE
DISCLAIMED. IN NO EVENT SHALL THE COPYRIGHT HOLDER OR CONTRIBUTORS BE LIABLE
FOR ANY DIRECT, INDIRECT, INCIDENTAL, SPECIAL, EXEMPLARY, OR CONSEQUENTIAL
DAMAGES (INCLUDING, BUT NOT LIMITED TO, PROCUREMENT OF SUBSTITUTE GOODS OR
SERVICES; LOSS OF USE, DATA, OR PROFITS; OR BUSINESS INTERRUPTION) HOWEVER
CAUSED AND ON ANY THEORY OF LIABILITY, WHETHER IN CONTRACT, STRICT LIABILITY,
OR TORT (INCLUDING NEGLIGENCE OR OTHERWISE) ARISING IN ANY WAY OUT OF THE USE
OF THIS SOFTWARE, EVEN IF ADVISED OF THE POSSIBILITY OF SUCH DAMAGE.
**********************************************************************************/

/**********************************************************************************
**  ENVIROMENT VARIABILE
**********************************************************************************/

#ifndef SERVO_H_
    #define SERVO_H_

/**********************************************************************************
**  GLOBAL INCLUDES
**********************************************************************************/

#include <stdint.h>

/**********************************************************************************
**  DEFINES
**********************************************************************************/

//Enable the file trace debugger
//#define ENABLE_DEBUG
//file trace debugger
#ifdef ENABLE_DEBUG
    #include <cstdio.h> 
    #include "debug.h"
#endif
//If DEBUG is not needed, blank out the implementations
#ifndef DEBUG_H_
    #define DEBUG_VARS_PROTOTYPES()
    #define DEBUG_VARS()
    #define DSHOW( ... )
    #define DSTART( ... )
    #define DSTOP()
    #define DTAB( ... )
    #define DPRINT( ... )
    #define DPRINT_NOTAB( ... )
    #define DENTER( ... )
    #define DRETURN( ... )
    #define DENTER_ARG( ... )
    #define DRETURN_ARG( ... )
#endif

/**********************************************************************************
**  MACROS
**********************************************************************************/

/**********************************************************************************
**  NAMESPACE
**********************************************************************************/

//! @namespace custom namespace
namespace OrangeBot
{

/**********************************************************************************
**  TYPEDEFS
**********************************************************************************/

/**********************************************************************************
**  PROTOTYPE: STRUCTURES
**********************************************************************************/

/**********************************************************************************
**  PROTOTYPE: GLOBAL VARIABILES
**********************************************************************************/

/**********************************************************************************
**  PROTOTYPE: CLASS
**********************************************************************************/

/************************************************************************************/
//! @class      Servo
/************************************************************************************/
//!	@author     Orso Eric
//! @version    2021-12-23
//! @brief      Servo Class
//! @copyright  BSD 3-Clause License Copyright (c) 2020, Orso Eric
//! @details
//! \n  Event based servo motor handler for microcontroller
//! \n  The first working code was first developed for Unit Zero running on an AT324
//! \n  OrangeBot uses an interface in class form that can be recylced
//! \n  The Engine comes from Unit Zero
//! \n  The class uses a single high resolution event timer to schedule pin change of servo channels
//! \n  Modulation is PPM, 50Hz with a deadtime of 1.5ms by default
//! \n  Class features an HAL to allow microcontroller specific hardware code interface to be encapsulated
//! \n  Use inheritance to inherit the interface class Servo_hal written for the implementation
/************************************************************************************/

class Servo
{
    //Visible to all
    public:
        /*********************************************************************************************************************************************************
        **********************************************************************************************************************************************************
        **  PUBLIC ENUMS
        **********************************************************************************************************************************************************
        *********************************************************************************************************************************************************/
    
        //! @brief Configurations of the class
        typedef enum _Config
        {
            SAFETY_CHECK = true,
            PEDANTIC_CHECKS = true,
			//Soft start configurations
			SOFT_START_TON = 10,
			SOFT_START_TOFF = 100,
			SOFT_START_TREDUCE = 1,
			SOFT_START_REPEAT = 2,
			SOFT_START_DELAY_US = 1,
			
        } Config;
        
        //! @brief Error codes of the class
        typedef enum _Error_code
        {
            OK,             //OK
            RECOVERY_FAIL,  //error_recovery() failed to recover from an error
        } Error_code;

        /*********************************************************************************************************************************************************
        **********************************************************************************************************************************************************
        **  PUBLIC TYPEDEFS
        **********************************************************************************************************************************************************
        *********************************************************************************************************************************************************/
        
        /*********************************************************************************************************************************************************
        **********************************************************************************************************************************************************
        **  CONSTRUCTORS
        **********************************************************************************************************************************************************
        *********************************************************************************************************************************************************/

        //Empty Constructor
        Servo( void );

        /*********************************************************************************************************************************************************
        **********************************************************************************************************************************************************
        **  DESTRUCTORS
        **********************************************************************************************************************************************************
        *********************************************************************************************************************************************************/

        //Empty destructor
        ~Servo( void );

        /*********************************************************************************************************************************************************
        **********************************************************************************************************************************************************
        **  PUBLIC OPERATORS
        **********************************************************************************************************************************************************
        *********************************************************************************************************************************************************/

        /*********************************************************************************************************************************************************
        **********************************************************************************************************************************************************
        **  PUBLIC SETTERS
        **********************************************************************************************************************************************************
        *********************************************************************************************************************************************************/

        /*********************************************************************************************************************************************************
        **********************************************************************************************************************************************************
        **  PUBLIC GETTERS
        **********************************************************************************************************************************************************
        *********************************************************************************************************************************************************/

        //Get current error state of the library
        Error_code get_error( void );

        /*********************************************************************************************************************************************************
        **********************************************************************************************************************************************************
        **  PUBLIC TESTERS
        **********************************************************************************************************************************************************
        *********************************************************************************************************************************************************/

        /*********************************************************************************************************************************************************
        **********************************************************************************************************************************************************
        **  PUBLIC METHODS
        **********************************************************************************************************************************************************
        *********************************************************************************************************************************************************/

		//Power ON or OFF the SERVOs
		bool power( bool iu8_powered );

        /*********************************************************************************************************************************************************
        **********************************************************************************************************************************************************
        **  PUBLIC STATIC METHODS
        **********************************************************************************************************************************************************
        *********************************************************************************************************************************************************/

        /*********************************************************************************************************************************************************
        **********************************************************************************************************************************************************
        **  PUBLIC VARS
        **********************************************************************************************************************************************************
        *********************************************************************************************************************************************************/

    //Visible to derived classes
    protected:
        /*********************************************************************************************************************************************************
        **********************************************************************************************************************************************************
        **  PROTECTED METHODS
        **********************************************************************************************************************************************************
        *********************************************************************************************************************************************************/

        /*********************************************************************************************************************************************************
        **********************************************************************************************************************************************************
        **  PROTECTED VARS
        **********************************************************************************************************************************************************
        *********************************************************************************************************************************************************/

    //Visible only inside the class
    private:
        /*********************************************************************************************************************************************************
        **********************************************************************************************************************************************************
        **	PRIVATE ENUM
        **********************************************************************************************************************************************************
        *********************************************************************************************************************************************************/
        
        /*********************************************************************************************************************************************************
        **********************************************************************************************************************************************************
        **	PRIVATE TYPEDEFS
        **********************************************************************************************************************************************************
        *********************************************************************************************************************************************************/
    
        /*********************************************************************************************************************************************************
        **********************************************************************************************************************************************************
        **	PRIVATE HAL
        **********************************************************************************************************************************************************
        *********************************************************************************************************************************************************/

        //HAL driver. Initialize IO pins
        bool hal_init_io( void );
        //Set the IO level of a given servo pin to a given value
        bool hal_servo_io( uint8_t iu8_index, bool iu1_value );
        //HAL driver. Initialize 
        //bool hal_init_timer( void );
		//Fixed Delay
		bool hal_delay_us( void );
		//Set power pin of the SERVO banks. false = disconnected | true = powered
		bool hal_power( bool iu8_powered );

        /*********************************************************************************************************************************************************
        **********************************************************************************************************************************************************
        **	PRIVATE INIT
        **********************************************************************************************************************************************************
        *********************************************************************************************************************************************************/
        
        //Initialize class vars
        bool init_class_vars( void );
        
        /*********************************************************************************************************************************************************
        **********************************************************************************************************************************************************
        **	PRIVATE METHODS
        **********************************************************************************************************************************************************
        *********************************************************************************************************************************************************/
        
        //Report an error. return false: OK | true: Unknown error code 
        bool report_error( Error_code error_code_tmp );
        //Tries to recover from an error. Automatically called by get_error. return false = OK | true = fail
        bool error_recovery( void );
		//Blocking hardwired version of the soft start method using delay and direct control of IOs
		bool soft_start( uint8_t iu8_ton, uint8_t iu8_toff, uint8_t iu8_treduce, uint8_t iu8_repeat );
		

        //Servo method to copy the code
        bool dummy( void );

        /*********************************************************************************************************************************************************
        **********************************************************************************************************************************************************
        **	PRIVATE VARS
        **********************************************************************************************************************************************************
        *********************************************************************************************************************************************************/

        //! @brief Error code of the class
        Error_code g_error;

};	//End Class: Servo

/*********************************************************************************************************************************************************
**********************************************************************************************************************************************************
**	CONSTRUCTORS
**********************************************************************************************************************************************************
*********************************************************************************************************************************************************/

/***************************************************************************/
//! @brief Constructor
//! \n Servo | void
/***************************************************************************/
// @param
//! @return no return
//! @details
//! \n Empty constructor
/***************************************************************************/

Servo::Servo( void )
{
    DENTER();   //Trace Enter
    ///--------------------------------------------------------------------------
    ///	BODY
    ///--------------------------------------------------------------------------

    //Initialize class vars
    this -> init_class_vars();

    ///--------------------------------------------------------------------------
    ///	RETURN
    ///--------------------------------------------------------------------------
    DRETURN();  //Trace Return
    return;
}   //end constructor: Servo | void

/*********************************************************************************************************************************************************
**********************************************************************************************************************************************************
**	DESTRUCTORS
**********************************************************************************************************************************************************
*********************************************************************************************************************************************************/

/***************************************************************************/
//!	@brief Destructor
//! \n Servo | void
/***************************************************************************/
// @param
//! @return no return
//! @details
//! \n Empty destructor
/***************************************************************************/

Servo::~Servo( void )
{
    DENTER();		//Trace Enter
    ///--------------------------------------------------------------------------
    ///	INIT
    ///--------------------------------------------------------------------------

    ///--------------------------------------------------------------------------
    ///	BODY
    ///--------------------------------------------------------------------------

    ///--------------------------------------------------------------------------
    ///	RETURN
    ///--------------------------------------------------------------------------
    DRETURN();      //Trace Return
    return;         //OK
}   //end destructor: Servo | void

/*********************************************************************************************************************************************************
**********************************************************************************************************************************************************
**	PUBLIC GETTERS
**********************************************************************************************************************************************************
*********************************************************************************************************************************************************/

/***************************************************************************/
//! @brief Public getter
//! \n get_error | void |
/***************************************************************************/
//! @return Error_code
//! @details
//! \n Get current error state of the library
//! \n Try to recover from errors
/***************************************************************************/

inline Servo::Error_code Servo::get_error( void )
{
    DENTER(); //Trace Enter
    ///--------------------------------------------------------------------------
    ///	BODY
    ///--------------------------------------------------------------------------

    //Fetch error
    Error_code err_code = this -> g_error;
    //Try to recover from error
    bool f_ret = this -> error_recovery();
    //If: failed to recover
    if (f_ret == true)
    {
        //Do nothing
    }

    ///--------------------------------------------------------------------------
    ///	RETURN
    ///--------------------------------------------------------------------------
    DRETURN(); //Trace Return
    return err_code; //OK
}   //end getter: get_error | void |

/*********************************************************************************************************************************************************
**********************************************************************************************************************************************************
**	PUBLIC METHODS
**********************************************************************************************************************************************************
*********************************************************************************************************************************************************/

/***************************************************************************/
//! @brief Private method
//! \n dummy | void
/***************************************************************************/
//! @param iu1_powered | bool | false = disconnected | true = powered |
//! @return bool | false = OK | true = FAIL |
//! @details
//! \n Method
/***************************************************************************/

bool Servo::power( bool iu1_powered )
{
	DENTER_ARG("SERVO power: %d", iu1_powered); //Trace Enter
	///--------------------------------------------------------------------------
	///	VAR
	///--------------------------------------------------------------------------
	
	//Return propagation
	bool u1_ret;
	
	///--------------------------------------------------------------------------
	///	BODY
	///--------------------------------------------------------------------------

	//SERVO OFF
	if (iu1_powered == false)
	{
		//Turn off SERVO bank
		u1_ret = this -> hal_power( false );
	}
	//SERVO ON
	else
	{
		//Use a blocking soft start delay based routine
		u1_ret = this -> soft_start( Config::SOFT_START_TON, Config::SOFT_START_TOFF, Config::SOFT_START_TREDUCE, Config::SOFT_START_REPEAT );
	}

	///--------------------------------------------------------------------------
	///	RETURN
	///--------------------------------------------------------------------------
	DRETURN_ARG("Success: %d", u1_ret); //Trace Return
	return u1_ret;	//Propagate Error
}   //end private method:


/*********************************************************************************************************************************************************
**********************************************************************************************************************************************************
**	PRIVATE HAL
**********************************************************************************************************************************************************
*********************************************************************************************************************************************************/

/***************************************************************************/
//! @brief Private HAL
//! \n hal_init_io | void
/***************************************************************************/
//! @return bool | false = OK | true = FAIL |
//! @details
//! \n HAL Driver
//! \n Initialize the IOs connected to the servomotors
/***************************************************************************/

bool Servo::hal_init_io( void )
{
    DENTER(); //Trace Enter
    ///--------------------------------------------------------------------------
    ///	INIT
    ///--------------------------------------------------------------------------

    ///--------------------------------------------------------------------------
    ///	BODY
    ///--------------------------------------------------------------------------

    ///--------------------------------------------------------------------------
    ///	RETURN
    ///--------------------------------------------------------------------------
    DRETURN(); //Trace Return
    return false;	//OK
}   //end private HAL: hal_init_io

/***************************************************************************/
//! @brief Private HAL
//! \n hal_delay_us | void
/***************************************************************************/
//! @return bool | false = OK | true = FAIL |
//! @details
//! \n HAL Driver
//! \n Fixed delay
/***************************************************************************/

bool Servo::hal_delay_us( void )
{
	///--------------------------------------------------------------------------
	///	BODY
	///--------------------------------------------------------------------------

	_delay_us( Config::SOFT_START_DELAY_US );
	
	///--------------------------------------------------------------------------
	///	RETURN
	///--------------------------------------------------------------------------
	
	return false;	//OK
}   //end private HAL: hal_delay_us


/***************************************************************************/
//! @brief Private HAL
//! \n hal_power | void
/***************************************************************************/
//! @param iu8_powered | bool | false = disconnected | true = powered |
//! @return bool | false = OK | true = FAIL |
//! @details
//! \n HAL Driver
//! \n Set power pin of the SERVO banks. false = disconnected | true = powered
/***************************************************************************/

bool Servo::hal_power( bool iu8_powered )
{
	///--------------------------------------------------------------------------
	///	BODY
	///--------------------------------------------------------------------------


	//Servo disconnected
	if (iu8_powered == false)
	{
		SET_BIT( SERVO_PWR_PORT.OUT, SERVO_PWR_PIN );
	}
	//Servo powered
	else
	{
		CLEAR_BIT( SERVO_PWR_PORT.OUT, SERVO_PWR_PIN );	
	}

	///--------------------------------------------------------------------------
	///	RETURN
	///--------------------------------------------------------------------------
	
	return false;	//OK
}   //end private HAL: hal_power


/*********************************************************************************************************************************************************
**********************************************************************************************************************************************************
**	PRIVATE INIT
**********************************************************************************************************************************************************
*********************************************************************************************************************************************************/

/***************************************************************************/
//! @brief Private Method
//! \n init_class_vars | void
/***************************************************************************/
// @param
//! @return no return
//! @details
//! \n Initialize class vars
/***************************************************************************/

bool Servo::init_class_vars( void )
{
    DENTER();		//Trace Enter
    ///--------------------------------------------------------------------------
    ///	INIT
    ///--------------------------------------------------------------------------

    ///--------------------------------------------------------------------------
    ///	BODY
    ///--------------------------------------------------------------------------

    ///--------------------------------------------------------------------------
    ///	RETURN
    ///--------------------------------------------------------------------------
    DRETURN();      //Trace Return
    return false;   //OK
}   //end method: init_class_vars | void

/*********************************************************************************************************************************************************
**********************************************************************************************************************************************************
**	PRIVATE METHODS
**********************************************************************************************************************************************************
*********************************************************************************************************************************************************/

/***************************************************************************/
//! @brief Private method
//! \n error_recovery | void |
/***************************************************************************/
//! @return return false = OK | true = fail
//! @details
//! \n Tries to recover from an error
//! \n Automatically called by get_error. 
/***************************************************************************/

bool Servo::error_recovery( void )
{
    DENTER(); //Trace Enter
    ///--------------------------------------------------------------------------
    ///	INIT
    ///--------------------------------------------------------------------------

    ///--------------------------------------------------------------------------
    ///	BODY
    ///--------------------------------------------------------------------------

    ///--------------------------------------------------------------------------
    ///	RETURN
    ///--------------------------------------------------------------------------
    DRETURN();      //Trace Return
    return true;    //FAIL
}   //end private method: error_recovery | void |

/***************************************************************************/
//!	@brief private method
//!	\n soft_start | uint8_t | uint8_t | uint8_t | uint8_t
/***************************************************************************/
//! @param iu8_ton | uint8_t | initial number of ON delays
//! @param iu8_toff | uint8_t | initial number of OFF delays
//! @param iu8_treduce | uint8_t | each cycle increase ON and decrease OFF by this number of delays
//! @param iu8_repeat | uint8_t | repeat ON OFF this number of repeats
//! @return bool | false = OK | true = FAIL |
//! @details
//!	\n	Blocking hardwired version of the soft start method using delay and direct control of IOs
//!	\n	@TODO: I can use TCA0 to emit pulses to EVOUTD in PWM mode for the soft start
/***************************************************************************/

bool Servo::soft_start( uint8_t iu8_ton, uint8_t iu8_toff, uint8_t iu8_treduce, uint8_t iu8_repeat )
{
	//----------------------------------------------------------------
	//	VARS
	//----------------------------------------------------------------

	bool u1_continue = true;

	//----------------------------------------------------------------
	//	BODY
	//----------------------------------------------------------------

	//While not done
	while (u1_continue == true)
	{
		//if: there is room to reduce Toff
		if (iu8_toff > iu8_treduce)
		{
			//For each repeat
			for (uint8_t u8_tmp = 0; u8_tmp < iu8_repeat; u8_tmp++)
			{
				//Power on
				CLEAR_BIT( SERVO_PWR_PORT.OUT, SERVO_PWR_PIN );
				
				for (uint8_t u8_tmp_b = 0; u8_tmp_b < iu8_ton; u8_tmp_b++)
				{
					this->hal_delay_us();
				}
				
				//Power Off
				this -> hal_power( false );
				
				//Wait
				for (uint8_t u8_tmp_b = 0; u8_tmp_b < iu8_toff; u8_tmp_b++)
				{
					this->hal_delay_us();
				}
			}
			
			//Increase Ton
			iu8_ton = iu8_ton+iu8_treduce;
			//Reduce Toff
			iu8_toff = iu8_toff-iu8_treduce;
		}
		//if: Reached Toff = 0
		else
		{
			//Power on
			this -> hal_power( true );
			//Break cycle
			u1_continue = false;
		}
	}

	//----------------------------------------------------------------
	//	RETURN
	//----------------------------------------------------------------
	
	return false;	//OK
}	//End private method: soft_start | uint8_t | uint8_t | uint8_t | uint8_t

/***************************************************************************/
//! @brief Private method
//! \n dummy | void
/***************************************************************************/
// @param
//! @return bool | false = OK | true = FAIL |
//! @details
//! \n Method
/***************************************************************************/

bool Servo::dummy( void )
{
    DENTER(); //Trace Enter
    ///--------------------------------------------------------------------------
    ///	INIT
    ///--------------------------------------------------------------------------

    ///--------------------------------------------------------------------------
    ///	BODY
    ///--------------------------------------------------------------------------

    ///--------------------------------------------------------------------------
    ///	RETURN
    ///--------------------------------------------------------------------------
    DRETURN(); //Trace Return
    return false;	//OK
}   //end private method:


/**********************************************************************************
**	NAMESPACE
**********************************************************************************/

} //End Namespace: User

#else
    #warning "Multiple inclusion of hader file SERVO_H_"
#endif
